extern "C" {
int sprintf ( char * str, const char * format, ... );
  void apiPrint(char* msg);
  int apiRead(char* name, int readofs, int readlen, void* targetofs);
};


extern const uint8_t egafont14x8[];
    
class CVideoAdapter
{
public:
    virtual bool PortWrite16(int port, int data) = 0;
    virtual bool PortWrite8(int port, int data) = 0;
    virtual bool PortRead8(int port, uint8_t& data) { assert(0); return false; }
    virtual bool Interrupt(CicoContext::cicocontext_t* ctx) = 0;
    virtual void Write(uint32_t dwAddr, uint8_t bWrite) = 0;
    virtual uint8_t Read(uint32_t dwAddr) = 0;
//    virtual uint32_t GetPixel(int x, int y) = 0;
    virtual void SetPixel(int x, int y, int c) = 0;
};
class CText : public CVideoAdapter
{
    uint8_t screen[25*80*32];
    uint32_t dacRegisters[64];
    uint32_t palette[16] = {
        0x000000, 0x0000b0, 0x00b000, 0x00b0b0, 0xb00000, 0xb000b0, 0xb0b000, 0xb0b0b0,
        0x808080, 0x0000ff, 0x00ff00, 0x00ffff, 0xff0000, 0xff00ff, 0xffff00, 0xffffff};
public:
    int posx{0}, posy{0};
    bool modified{false};
public:
    CText() : CVideoAdapter()
    {
        for (int i=0; i<80*25; i++)
        {
            screen[i*2] = 0*' '+255;
            screen[i*2+1] = 0x07;
        }
    }
    virtual bool PortWrite16(int port, int data) { return false; }
    virtual bool PortWrite8(int port, int data) { 
        static int lastPort = 0, lastData = 0;
        if (port == 0x3c8)
        {
            return true;
        }
        if (port == 0x3c9)
        {
            return true;
        }
        if ( port == 0x3c0 )
        {
            static int index = -1;
            if (index == -1)
            {
                if (data <= 0x10)
                    index = data;
            }
            else
            {
                SetPaletteIndex(index, data);
                index = -1;
            }
            return true;
        }
        return false; 
    }
    virtual bool PortRead8(int port, uint8_t& data) { assert(0); return false; }
    virtual bool Interrupt(CicoContext::cicocontext_t* ctx) {
        if (ctx->a.r8.h == 0x0f)
        {
            ctx->a.r16 = 0x5003;
            ctx->b.r8.h = 0x00;
            return true;
        }
        if (ctx->a.r8.h == 0x06)
            return true;
        if (ctx->a.r16 == 0x0003)
            return true;
        if (ctx->a.r16 == 0x0004)
            return true;
        if (ctx->a.r16 == 0x1200 && ctx->b.r8.l == 0x10)
        {
            ctx->b.r16 = 0x0003;
            ctx->c.r16 = 0x0009;
            return true;
        }
        if (ctx->a.r8.h == 0x1a)
        {
            ctx->a.r8.l = 0x1a;
            ctx->b.r8.l = 0x08; // vga color
            return true; 
        }
        if (ctx->a.r16 == 0x0103)
        {
//     set cursor type
            return true;
        }
        if (ctx->a.r16 == 0x1003)
        {
            return true;
        }
        if (ctx->a.r16 == 0x1110)
            return false;
        if (ctx->a.r16 == 0x1201)
            return true;
        if (ctx->a.r16 == 0x1103)
            return true;
        if (ctx->a.r16 == 0x1130)
        {
            //get current character generator information
            ctx->d.r8.l = 25;
            return true;
        }
        if (ctx->a.r16 == 0x0800)
        {
            // read char
            ctx->a.r8.l = screen[(posy*80+posx)*2];
            ctx->a.r8.h = screen[(posy*80+posx)*2+1];
            return true;
        }
        if (ctx->a.r8.h == 0x02)
        {
            posx = ctx->d.r8.l;
            posy = ctx->d.r8.h;
            return true;
        }
        if (ctx->a.r16 == 0x1112)
        {
            // chargen!
            return true;
        }
        if (ctx->a.r16 == 0x1010)
        {
            //http://www.techhelpmanual.com/144-int_10h_1010h__set_one_dac_color_register.html
//            printf("palette [%d]=%d,%d,%d\n", ctx->b.r16, ctx->c.r8.h, ctx->c.r8.l, ctx->d.r8.h);
//            assert(ctx->b.r16 < 16);
            int r = ctx->d.r8.h * 4;
            int g = ctx->c.r8.h * 4;
            int b = ctx->c.r8.l * 4;
            dacRegisters[ctx->b.r16] = b | (g << 8) | (r << 16);
            int index = ctx->b.r16;
            if (index == 20) index=6;
            if (index >= 56) index=index-56+8;
            palette[index] = r | (g << 8) | (b << 16);
            return true;
        }
        return false;

        assert(0);
return false;
    }
    virtual void Write(uint32_t dwAddr, uint8_t bWrite)
    {
        int ofs = dwAddr - 0xb0000;
        if (ofs < 0x8000)
         return;

        modified |= screen[ofs] != bWrite;
        assert(ofs >= 0 && ofs < sizeof(screen));
        screen[ofs] = bWrite;
    }
    virtual uint8_t Read(uint32_t dwAddr) { 
        int ofs = dwAddr - 0xb0000;
        if (ofs < 0x8000)
         return 0;

        assert(ofs >= 0 && ofs < sizeof(screen));
        return screen[ofs];
    }
/*
    virtual uint32_t GetPixel(int x, int y){
        if (y < 40 || y>=480-40)
            return 0;
        y -= 40;
        int row = y/3;
        int col = x/8;
        int subx = x%8;
        int suby = y%14;
        if (suby > 13)
            suby = 13;
        int ofs = 0x8000; // B000 - text, B800 - graphicss
        assert(ofs+(row*80+col)*2+1 < sizeof(screen));
        uint8_t symbol = screen[ofs+(row*80+col)*2]; // 219;//
        uint8_t attr = screen[ofs+(row*80+col)*2+1]; // 219;//
        return (egafont14x8[symbol*14+suby] & (128>>subx)) ? palette[attr & 0xf]  : palette[attr >> 4];
    };
*/
    virtual void SetPixel(int x, int y, int c) { return; };
public:
    void SetPaletteIndex(int index, int rgb)
    {
        /*
        int r = ((rgb & 4) ? 2 : 0) + ((rgb & 32) ? 1 : 0);
        int g = ((rgb & 2) ? 2 : 0) + ((rgb & 16) ? 1 : 0);
        int b = ((rgb & 1) ? 2 : 0) + ((rgb & 8) ? 1 : 0);
        r = r * 255 / 3;
        g = g * 255 / 3;
        b = b * 255 / 3;
        palette[index] = b | (g << 8) | (r << 16);
         */
        palette[index] = dacRegisters[rgb];
    }

    bool blit(uint32_t* pixels)
    {
        if (!modified)
            return false;
        modified = false;
        uint8_t *src = screen+0x8000;
        uint32_t* pix0 = pixels;
        uint32_t* pix1 = pixels+640;
        uint32_t* pix2 = pixels+640*2;
        uint32_t* pix3 = pixels+640*3;
        for (int y=0; y<100; y++)
        {
          for (int x=0; x<80; x++)
          {
            uint8_t symbol = *src++;
            uint8_t attr = *src++;
            uint32_t colors[2] = {palette[attr >> 4] | 0xff000000, palette[attr & 15] | 0xff000000};
            const uint8_t* pf = &egafont14x8[symbol*14];
            uint8_t f0 = *pf++;
            uint8_t f1 = *pf++;
            uint8_t f2 = *pf++;
            uint8_t f3 = *pf++;
            for (int xx=0; xx<8; xx++)
            {
              *pix0++ = colors[f0 >> 7];
              f0 <<= 1;
              *pix1++ = colors[f1 >> 7];
              f1 <<= 1;
              *pix2++ = colors[f2 >> 7];
              f2 <<= 1;
              *pix3++ = colors[f3 >> 7];
              f3 <<= 1;
            }
          }
          pix0 += 640*3;
          pix1 += 640*3;
          pix2 += 640*3;
          pix3 += 640*3;
        }
/*
            for (int x=0; x<350; x++)
        for (int y=0; y<640; y++)
            {
                *pixels++ = GetPixel(y, x) | 0xff000000;
            }
*/
        return true;
    }
};

const uint8_t egafont14x8[] = {
  0x00, 0x00, 0x00, 0x00, 0x00, 0x00, 0x00, 0x00,
  0x00, 0x00, 0x00, 0x00, 0x00, 0x00, 0x00, 0x00, 0x7e, 0x81, 0xa5, 0x81,
  0x81, 0xbd, 0x99, 0x81, 0x7e, 0x00, 0x00, 0x00, 0x00, 0x00, 0x7e, 0xff,
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  0x00, 0x00, 0x00, 0x00, 0x00, 0x00, 0x00, 0x00, 0x00, 0x00, 0x00, 0x00,
};
