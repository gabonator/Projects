// Other linker flags: /opt/homebrew/lib/libSDL2.dylib
// System header search paths: /opt/homebrew/include/SDL2

#include <assert.h>
#include <stdint.h>
#include <string.h>
#include <stdio.h>
#include "sdl.h"
#define _HOST
#include "cicoemu.h"
#include "ega.h"
#include <list>
#include "controls.h"
//#include "game/game.h"

namespace CicoContext{
    cicocontext_t* ctx;
}

CSdl mSdl;
//CEga mVideo;
CEga mEga;
CCga mCga;
CVga mVga;
CVideoAdapter* mVideo = &mEga;
int lastKey = -1;
char root[1024];
uint8_t mem[0xa0000];
extern unsigned char font[2048];
int headerSize = 0;

std::list<char> keyBuffer;

void _sync()
{
    for (int y=0; y<200; y++)
      for (int x=0; x<320; x++)
        mSdl.SetPixel(x, y, mVideo->GetPixel(x, y));
    mSdl.Loop();
}

void CicoContext::cicocontext_t::daa()
{
    // TODO: set carry before!
}
void CicoContext::cicocontext_t::das()
{
    // TODO: set carry before!
    //https://www.felixcloutier.com/x86/das
    int oldal = ctx->a.r8.l;
    int oldcf = ctx->carry;
    int af = 0;
    if ((ctx->a.r8.l & 0x0f) > 9 || af == 1)
    {
        ctx->a.r8.l -= 6;
        ctx->carry = false;
    } else
        af = 0;
    
    if (oldal > 0x99 || oldcf)
    {
        ctx->a.r8.l -= 0x60;
        ctx->carry = true;
    }
}

namespace CicoContext
{
uint8_t _memoryBiosGet8(int seg, int ofs)
{
    if (seg == 0xffff && ofs == 0x000e)
        return 0xfc;
    if (seg == 0xf000 && ofs == 0xfffe)
        return 0xfc; // pc at
    if (seg == 0x0040 && ofs == 0x0087)
        return 0x00; // ega active
    if (seg == 0x0040 && ofs == 0x0088)
        return 0x09;
    if (seg == 0x0040 && ofs == 0x0017) // http://www.powernet.co.za/info/bios/mem/40_0017.htm
        return 0x00; // shift keys
    if (seg == 0xf000 && ofs >= 0xfa6e && ofs < (0xfa6e + sizeof(font)))
        return font[ofs-0xfa6e];
    if (seg == 0x0040 && ofs == 0x0010)
        return 0x26;
    if (seg == 0x0040 && ofs == 0x006c)
    {
        auto getTick = []() -> uint32_t {
            struct timespec ts;
            unsigned theTick = 0U;
            clock_gettime( CLOCK_REALTIME, &ts );
            theTick  = ts.tv_nsec / 1000000;
            theTick += ts.tv_sec * 1000;
            return theTick;
        };

        return getTick()/54; // 0xd1; // number of ticks since midnight 54ms
    }
    if (seg == 0x0000 && ofs == 0x0000)
        return 0x1a;
    assert(0);
    return 0;
}
uint8_t _memoryPsp(int seg, int ofs)
{
    if (seg == 0x1d3)
    {
        const char env[] = "PATH=Z:\\" "\x00" "COMSPEC=Z:\\COMMAND.COM" "\x00"
          "BLASTER=A220 I7 D1 H5 T6" "\x00\x00\x01\x00" "C:\\BUM\\B.EXE"
          "\x00\x00\x00\x00\x00\x00\x00";
        if (ofs<sizeof(env))
            return env[ofs];
        assert(0);
        return 0;
    }
    if (seg == 0x1dd && ofs == 0x80)
        return 0;
    if (seg == 0x1dd && ofs == 0x81)
        return 0x0d;

    /*
    if (seg == 0x01d3)
    {
        return 0;
    }
    assert(seg == 0x01dd);
    switch (ofs)
    {
        case 0x80: return 0;
        case 0x81: return 0x0d;
        default:
            assert(0);
            return 0;
    }
     */
    assert(0);
}
uint16_t _memoryPsp16(int seg, int ofs)
{
    if (seg==0x1d3)
        return _memoryPsp(seg, ofs) | (_memoryPsp(seg, ofs+1)<<8);
    
    assert(seg == 0x1dd);
    // https://en.wikipedia.org/wiki/Program_Segment_Prefix
    switch (ofs)
    {
        case 0x02:
            //     Segment of the first byte beyond the memory allocated to the program
            return 0x9fff;
        case 0x2c:
            // Environment segment;
            return 0x1d3;
        default:
            assert(0);
            return 0;
    }
}


uint8_t CicoContext::cicocontext_t::memoryBiosGet8(int seg, int ofs)
{
    if ((seg == 0x01dd || seg == _loadAddress || seg == 0x01d3) && ofs < 256)
        return _memoryPsp(seg, ofs);
    return _memoryBiosGet8(seg, ofs);
}
void CicoContext::cicocontext_t::memoryBiosSet8(int seg, int ofs, uint8_t val)
{
    //    assert(0);
}
uint16_t _memoryBiosGet16(int seg, int ofs);
uint16_t CicoContext::cicocontext_t::memoryBiosGet16(int seg, int ofs)
{
    if ((seg == 0x01dd || seg == _loadAddress || seg == 0x01d3) && ofs < 256)
        return _memoryPsp16(seg, ofs);
    return _memoryBiosGet16(seg, ofs);
}
void _memoryBiosSet16(int seg, int ofs, uint16_t);

void CicoContext::cicocontext_t::memoryBiosSet16(int seg, int ofs, uint16_t val)
{
    if ((seg == 0x01dd || seg == _loadAddress) && ofs < 256)
        assert(0); // ???
    else
        _memoryBiosSet16(seg, ofs, val);
}

uint8_t cicocontext_t::memoryAGet8(int seg, int ofs)
{
    ofs &= 0xffff;
    if ((seg == 0x01ed || seg == 0x01dd || seg == 0x01d3) && ofs < 256)
        return _memoryPsp(seg, ofs);
    else
    if (seg >= 0x01ed && seg < 0xa000)
        return memory8(seg, ofs);
    else if (seg >= 0xa000 && seg < 0xe000)
        return memoryVideoGet8(seg, ofs);
    else
        return memoryBiosGet8(seg, ofs); // bios
}
void _memoryBiosSet8(int seg, int ofs, uint8_t v)
{
    printf("skip bios write %x:%x = %x\n", seg, ofs, v);
}
void _memoryBiosSet16(int seg, int ofs, uint16_t v)
{
    printf("skip bios write %x:%x = %x\n", seg, ofs, v);
}

uint16_t _memoryBiosGet16(int seg, int ofs)
{
    if (seg == 0x0040 && ofs == 0x006c) // timer
        return 0;
    if (seg == 0x0000 && ofs == 0x041a) // int?
        return 0;
    if (seg == 0x0040 && ofs == 0x0063) // int?
        return 0x3d4;
    if (seg == 0x0000 && ofs < 400)
        return 0;
    if (seg == 0x0040 && ofs == 0x0080)
        return 0x1e;
    assert(0);
    return 0;
}
uint16_t cicocontext_t::memoryAGet16(int seg, int ofs)
{
    if (seg == 0xa57 && ofs == 0x007e)
    {
        int f = 9;
    }
    ofs &= 0xffff;
    if ((seg == 0x01dd || seg == 0x01ed || seg == 0x01d3) && ofs < 256)
        return _memoryPsp16(seg, ofs);
    else if (seg >= 0x01ed && seg < 0xa000)
        return memory16(seg, ofs);
    else if (seg >= 0xa000 && seg < 0xe000)
        return memoryVideoGet16(seg, ofs);
    else
        return memoryBiosGet16(seg, ofs);
        //assert(0); // bios
}

void cicocontext_t::memoryASet8(int seg, int ofs, uint8_t val)
{
    ofs &= 0xffff;
    if ((seg == 0x01dd || seg == 0x01ed) && ofs < 256)
        assert(0);
    else if (seg >= 0x01ed && seg < 0xa000)
        memory8(seg, ofs) = val;
    else if (seg >= 0xa000 && seg < 0xe000)
        memoryVideoSet8(seg, ofs, val);
    else
        memoryBiosSet8(seg, ofs, val);
}

void cicocontext_t::memoryASet16(int seg, int ofs, uint16_t val)
{
    ofs &= 0xffff;
    if (seg*16+ofs==0x12280 + 0x4dfe)
    {
        printf("setting 1228:4dfe <= %04x\n", val);
        int f =9;
    }
    if (seg*16+ofs==0x12280 + 0x4e00)
    {
        printf("setting 1228:4e00 <= %04x\n", val);
        int f = 9;
    }

    if ((seg == 0x01dd || seg == 0x01ed) && ofs < 256)
    {
        assert(0); // ???
    }
    else
    if (seg >= 0x01ed && seg < 0xa000)
        memory16(seg, ofs) = val;
    else if (seg >= 0xa000 && seg < 0xe000)
        memoryVideoSet16(seg, ofs, val);
    else
        memoryBiosSet16(seg, ofs, val);
}

uint8_t& cicocontext_t::memory8(int seg, int ofs){
    if (seg*16+ofs==0x12280 +0x4e00)
    {
        int f = 9;
    }
    if (seg*16+ofs==0x3f430 + 0x0004)
    {
        int f = 9;
    }
    assert(seg >= 0x01ed && seg < 0xa000 && ofs >= 0 && ofs <= 0xffff);
    int addr = seg*16 + ofs;
    addr -= 0x01ed0 - headerSize;
    assert(addr > 0 && addr < sizeof(mem));
    if (addr == 0x86d2)
    {
        int f = 9;
    }
    return mem[addr];
}

uint16_t& cicocontext_t::memory16(int seg, int ofs){
    assert(seg >= 0x01ed && seg < 0xa000 && ofs >= 0 && ofs <= 0xffff);
    int addr = seg*16 + ofs;
    addr -= 0x01ed0 - headerSize;
    assert(addr > 0 && addr < sizeof(mem));
    return *(uint16_t*)&mem[addr];
}

uint8_t cicocontext_t::memoryVideoGet8(int seg, int ofs)
{
    return mVideo->Read(seg*16+ofs);
}

void cicocontext_t::memoryVideoSet8(int seg, int ofs, uint8_t data)
{
    mVideo->Write(seg*16+ofs, data);
}

uint16_t cicocontext_t::memoryVideoGet16(int seg, int ofs)
{
    assert(0);
    return 0;
}

void cicocontext_t::memoryVideoSet16(int seg, int ofs, uint16_t data)
{
    assert(data == 0);
    memoryVideoSet8(seg, ofs, data & 0xff);
    memoryVideoSet8(seg, ofs+1, data >> 8);
}

void cicocontext_t::_int(int i)
{
    static FILE* f = nullptr;
    if (i == 0x10 && ctx->a.r16 == 0x1012)
    {
        int f = 9;
    }
    if (i == 0x12)
    {
        ctx->a.r16 = 0x800;
        return;
    }
    if (i == 0x21 && ctx->a.r8.h == 0x09)
    {
        for(int i=0; i<200; i++)
        {
            char c = ctx->memory8(ctx->_ds, ctx->d.r16+i);
            assert(c);
            if (c == '$')
                return;
            printf("%c", c);
        }
        assert(0);
    }

    if (i == 0x21 && ctx->a.r8.h == 0x3d)
    {
        // read file DS:DX filename
        // AX = file handle
        char filename[100];
        int j = 0;
        for (int i=0; i<100; i++)
        {
            char c = ctx->memory8(ctx->_ds, ctx->d.r16+i);
            if (!c)
                break;
            if (c >= 'a' && c <= 'z')
                c -= 'a' - 'A';
            if (c != ' ')
            {
                filename[j++] = c;
                filename[j] = 0;
            }
        }
        printf("Opening %s\n", filename);
        //char fullname[128] = "/Users/gabrielvalky/Documents/git/Projects/XenonResurrection/Input/binary/";
        char fullname[1024];
        strcpy(fullname, root);
        strcat(fullname, "/");
        strcat(fullname, filename);
        for (int i=0; i<128 && fullname[i]; i++)
            if (fullname[i] == '\\')
                fullname[i] = '/';
        
        ctx->carry = 0;
        assert(f == nullptr);
        ctx->a.r16 = 5;
        
        f = fopen(fullname, "rb");
        if(!f)
        {
            printf("Not found: %s\n", filename);
            assert(0);
            ctx->carry = 1;
            ctx->a.r16 = 0;
        }
        return;

    }
    if (i == 0x21 && ctx->a.r8.h == 0x3f)
    {
        // read file CX bytes => CS:DX
        if (!f)
        {
            printf("no file opened!\n");
            return;
        } else {
            printf("Read %d bytes -> %04x:%04x\n", ctx->c.r16, ctx->_ds, ctx->d.r16);
            uint8_t* buf = new uint8_t[ctx->c.r16];
            int c = fread(buf, 1, (size_t)ctx->c.r16, f);
            for (int i=0; i<c; i++)
                ctx->memoryASet8(ctx->_ds, ctx->d.r16+i, buf[i]);
            delete[] buf;
            //std::cout << "read " << _cx << " (" << c << ")" << endl;
            assert(c);
            ctx->a.r16 = c;
            ctx->carry = 0;
            return;
        }
    }
    if (i == 0x21 && ctx->a.r8.h == 0x3e)
    {
        fclose(f);
        f = nullptr;
        ctx->carry = 0;
        return;
    }
    static int _videoMode = -1;
    if (i == 0x10 && ctx->a.r8.h == 0x00)
    {
        // set video mode
        printf("Set video mode: %d\n", ctx->a.r8.l);
        _videoMode = ctx->a.r8.l;
        switch (ctx->a.r8.l)
        {
            case 0x13:
                mVideo = &mVga; break;
            case 13:
            case 0x12:
            case 0x10:
            case 0x02: // 80x25 16 shades of gray text (CGA,EGA,MCGA,VGA)?

            case 1:
                mVideo = &mEga; break;
            case 4:
                mVideo = &mCga; break;
            case 3: // exit
                break;
            default:
                assert(0);
        }
        return;
    }
    if (i == 0x21 && ctx->a.r8.h == 0x25)
    {
        // set int vect AL DS:DX
        printf("Set int vector - ignore\n");
        return;
    }
    if (i == 0x21 && ctx->a.r8.h == 0x35)
    {
        printf("Get int vector - ignore\n");
        ctx->_es = 0;
        ctx->b.r16 = 0;
        
        ctx->b.r16 = 0x1060;
        ctx->_es = 0xf000;
        return;
    }
    if (i == 0x33)
    {
        // mouse
        ctx->a.r16 = 0;
        return;
    }
    if (i == 0x21 && ctx->a.r8.h == 0x3c)
    {
        // create file
        ctx->carry = true;
        return;
    }
    //static int lastKey = -1;
    if (i == 0x16 && ctx->a.r8.h == 0x00)
    {
        ctx->a.r16 = lastKey;
        lastKey = -1;
        return;
    }
    if (i == 0x16 && ctx->a.r8.h == 0x01)
    {
        ctx->zero = lastKey == -1;
        return;
    }
    if (i == 0x10 && ctx->a.r8.h == 0x06)
        return;
    if (i == 0x21 && ctx->a.r8.h == 0x4a)
    {
        ctx->carry = false;
        return;
    }
    if (i == 0x21 && ctx->a.r8.h == 0x48)
    {
        static int freeMem = 0x1D9E;
        // _bx size
        printf("malloc %d bytes -> %04x:0000\n", ctx->b.r16, freeMem);
        ctx->a.r16 = freeMem;
        freeMem += ctx->b.r16;
        freeMem ++;
        ctx->carry = false;
        return;
    }
    if (i == 0x21 && ctx->a.r8.h == 0x40)
        return;
    if (i == 0x21 && ctx->a.r8.h == 0x3e)
        return;
    if (i == 0x21 && ctx->a.r8.h == 0x49)
        return;
    if (i == 0x21 && ctx->a.r8.h == 0x0a)
    {
        memory8(ctx->_ds, ctx->d.r16) = 'n';
        return;
    }
    if (i == 0x10 && ctx->a.r8.h == 0x0f)
    {
        if (_videoMode==-1)
        {
            ctx->a.r16 = 0x5003;
            ctx->b.r8.h = 0x00;
            return;
        }
        if (_videoMode==0x12)
        {
            ctx->a.r16 = 0x5012;
            ctx->b.r8.h = 0x00;
            return;
        }
        if (_videoMode==0x13)
        {
            ctx->a.r16 = 0x2813;
            ctx->b.r8.h = 0x00;
            return;
        }
        if (_videoMode==0x10)
        {
            ctx->a.r16 = 0x5010;
            ctx->b.r8.h = 0x00;
            return;
        }
        if (_videoMode==0x4)
        {
            ctx->a.r16 = 0x2804;
            ctx->b.r8.h = 0x00;
            return;
        }
        assert(0);
    }
    if (i == 0x10 && ctx->a.r8.h == 0x1a)
    {
        //https://dos4gw.org/INT_10H_1aH_Set_or_Query_Display_Combination_Code
        ctx->a.r8.l = 0x1a;
        ctx->b.r8.l = 0x08; // vga color
        return;
        
    }
    if (i == 0x10 && ctx->a.r8.h == 0x10 && ctx->a.r8.l == 0)
    {
        //cout << hex << "\nset text palette[" << (int)_bl << "] = " << (int)_bh << endl;
        mEga.SetPaletteIndex(ctx->b.r8.l, ctx->b.r8.h);
        return;
    }
    if (i == 0x10 && ctx->a.r16 == 0x1012)
    {
        mEga.Interrupt(ctx);
        return;
    }
    if (i == 0x10 && mVideo)
    {
        if (mVideo->Interrupt(ctx))
            return;
    }
    if (i == 0x21 && ctx->a.r8.h == 0x2c)
    {
        printf("get time\n");
        ctx->c.r8.h = 1; // hr
        ctx->c.r8.l = 20; // min
        ctx->d.r8.h = 17; // sec
        ctx->d.r8.l = 50; // hundredths
        return;
    }
    if (i == 0x21 && ctx->a.r8.h == 0x44)
    {
        ctx->a.r16 = 0x80d3;
        ctx->d.r16 = 0x80d3;
        ctx->carry = 0;
        return;
    }
    if (i == 0x21 && ctx->a.r8.h == 0x30)
    {
        ctx->a.r16 = 0x0005;
        ctx->b.r16 = 0xff00;
        ctx->c.r16 = 0x0000;
        return;
    }
    if (i == 0x1A)
    {
        auto getTick = []() -> uint32_t {
            struct timespec ts;
            unsigned theTick = 0U;
            clock_gettime( CLOCK_REALTIME, &ts );
            theTick  = ts.tv_nsec / 1000000;
            theTick += ts.tv_sec * 1000;
            return theTick;
        };

        static uint32_t base = 0;
        int now = getTick();
        if (ctx->a.r8.h == 4)
        {
            
        }
        else if (ctx->a.r8.h == 0)
        {
            if (base == 0)
                base = now;
            now -= base;
            now = now /6; //* 65536 / (1000*60*60);
            ctx->c.r16 = now >> 16;
            ctx->d.r16 = now & 0xffff;
        } else {
            assert(ctx->a.r8.h == 1 && ctx->c.r16 == 0 && ctx->d.r16 == 0);
            base = now;
        }
        return;
    }
    if (i == 0x21 && ctx->a.r8.h == 0x42)
    {
        if (ctx->a.r8.l == 2 && ctx->c.r16 == 0 && ctx->d.r16 == 0)
        {
            assert(f);
            fseek(f, 0L, SEEK_END);
            ctx->a.r16 = ftell(f);
            fseek(f, 0L, SEEK_SET);
            ctx->d.r16 = 0;
            return;
        }
        if (ctx->a.r8.l == 0 && ctx->d.r16 == 0)
        {
            assert(f);
            fseek(f, ctx->c.r16, SEEK_SET);
            return;
        }

    }
    if (i == 0x21 && ctx->a.r8.h == 0x0b)
    {
        ctx->a.r8.l = keyBuffer.empty() ? 0 : 0xff; // check key
        return;
    }
    if (i == 0x21 && ctx->a.r8.h == 0x07)
    {
        ctx->a.r8.l = keyBuffer.front(); // key stdin
        keyBuffer.pop_front();
        return;
    }
    if (i == 0x11)
    {
        ctx->a.r16 = 0;
        return;
    }
    if (i == 0x21 && ctx->a.r8.h == 0x42)
    {
        if (ctx->a.r8.l == 2 && ctx->c.r16 == 0 && ctx->d.r16 == 0)
        {
            assert(f);
            fseek(f, 0L, SEEK_END);
            ctx->a.r16 = ftell(f);
            fseek(f, 0L, SEEK_SET);
            ctx->d.r16 = 0;
            return;
        }
        if (ctx->a.r8.l == 1)
        {
            assert(ctx->c.r16 == 0);
            assert(f);
            fseek(f, ctx->d.r16, SEEK_CUR);
            ctx->d.r16 = ftell(f);
            ctx->a.r16 = 0;
            return;
        }
        if (ctx->a.r8.l == 1 && ctx->d.r16 == 0)
        {
            assert(f);
            fseek(f, ctx->c.r16, SEEK_CUR);
            return;
        }
        if (ctx->a.r8.l == 0)
        {
            assert(f);
            fseek(f, ctx->d.r16, SEEK_SET);
            return;
        }

    }
    if (i == 0x21 && ctx->a.r8.h == 0x19)
    {
        ctx->a.r8.l = 0x02;
        return;
    }
    if (i == 0x15 && ctx->a.r8.h == 0x06)
    {
        //wtf?
        return;
    }
    if (i == 0x21 && ctx->a.r8.h == 0x43)
    {
        // read file DS:DX filename
        // AX = file handle
        char filename[100];
        for (int i=0; i<100; i++)
        {
            char c = ctx->memory8(ctx->_ds, ctx->d.r16+i);
            if (!c)
                break;
            if (c >= 'a' && c <= 'z')
                c -= 'a' - 'A';
            filename[i] = c;
            filename[i+1] = 0;
        }
        printf("GetAttribute %s\n", filename);
        ctx->c.r16 = 1<<5;
        return;
    }

    if (i == 0x10 && ctx->a.r16 == 0x1015)
    {
        // read dac @ bx, ch, cl, dh
        return;
    }
    printf("int %d\n", i);
    assert(0);
}
void cicocontext_t::out(int port, uint16_t val)
{
    if (mVideo->PortWrite16(port, val))
    {
        return;
    }
    printf("skip write %x, %x\n", port, val);
}
void cicocontext_t::out(int port, uint8_t val)
{
    if (mVideo->PortWrite8(port, val))
    {
        return;
    }
    printf("skip write %x, %x\n", port, val);
}

void cicocontext_t::in(uint8_t& val, int port)
{
    if (port == 0x3da)
    {
        static int retrace = 0;
        retrace++;
        val = (retrace & 1) ? 9 : 0;
        return;
    }
    if (port == 0x201)
    {
//        printf("joystick skip\n");
        val = 0;
        return;
    }
    if (port == 0x61)
    {
        printf("timer skip\n");
        return;
    }
    if (port == 0x3c9)
    {
        if (mVga.PortRead8(port, val))
            return;
    }
    if (port == 0x388) //audio
    {
        val = 0x60;
        return;
    }
    if (port == 0x3b5) //mono
    {
        val = 0xff;
        return;
    }
    if (port == 0x301)
    {
        val = 0xff;
        //?
        return;
    }
    if (port == 0x331)
    {
        val = 0xbf;
        //?
        return;
    }
    if (port == 0x40)
    {
        static int counter = 0;
        val = (counter++ & 2) ? 0xff:0x00;
        return;
    }

    if (port == 0x3d4 || port == 0x3d5)
    {
        printf("skip pal\n");
        return;
    }

    assert(0);
}

void cicocontext_t::push(const uint16_t& r)
{
    if (r==0x8888)
    {
        int f = 9;
    }
    if (ctx->_sp < 20)
    {
        int f = 9;
    }
    ctx->_sp -= 2;
    memory16(ctx->_ss, ctx->_sp) = r;
    assert(ctx->_sp > 0);
}
int checksp = -1;
uint16_t cicocontext_t::pop(void)
{
    assert(ctx->_sp <= 0xffff);
    uint16_t aux = memory16(ctx->_ss, ctx->_sp);
    if (checksp)
    {
        if (aux == checksp)
        {
            int f = 9;
        }
        
    }
    ctx->_sp += 2;
    return aux;
}
void cicocontext_t::push(const int& r)
{
    assert(r >= 0 && r <= 0xffff);
    ctx->_sp -= 2;
    memory16(ctx->_ss, ctx->_sp) = r;
}
//void cicocontext_t::pop(int& r)
//{
//    ctx->_sp += 2;
//    r = memory16(ctx->_ss, ctx->_sp);
//}
bool cicocontext_t::stop(const char* msg)
{
    assert(0);
    return false;
}

void cicocontext_t::cbw()
{
    ctx->a.r8.h = (ctx->a.r8.l & 0x80) ? 0xff : 0;
}
void cicocontext_t::div(uint16_t r)
{
    uint16_t result = ctx->a.r16 / r;
    uint16_t remain = ctx->a.r16 % r;
    ctx->a.r16 = result;
    ctx->d.r16 = remain;
}
void cicocontext_t::div(uint8_t r)
{
    uint16_t result = ctx->a.r16 / r;
    uint16_t remain = ctx->a.r16 % r;
    ctx->a.r8.l = result;
    ctx->d.r8.h = remain;
}
}

void sub_bb32();
void sub_c91e();
void sub_df4f();
void sub_fb7f();
void sub_c27e();
void sub_f9c4();
void sub_e600();
void sub_e2e4();
void sub_ca60();
void sub_ca8b();
void sub_12245();
void sub_d016();
void sub_d080();
void sub_d0d7();
void sub_d500();
void sub_d530();
void sub_d250();
void sub_d283();
void sub_dac0();
void sub_dae7();
void sub_fbb9();
void sub_fdcd();

void sub_204d();
void sub_5d62();
void sub_8e60();
void sub_9032();
void sub_43e0();
void sub_45b7();
void sub_9082();
void sub_4611();
void sub_4862();
void sub_4778();
void sub_8edf();
void sub_4430();
void sub_8f3c();
void sub_4677();
void sub_90d3();
void sub_4666();
void sub_86d9();
void sub_90e2();
void sub_44c3();
void sub_8fb6();
void sub_9112();
void sub_47b2();
void sub_9028();
void sub_8ed9();
void sub_444c();
void sub_8fa0(); // 08e6:0140
void sub_4bde();
void sub_4bd1();
void sub_4918();
void sub_8f74();
void sub_4464();
void sub_4918();
void sub_4628();
void sub_8f86();
void sub_4693();
void sub_4928();
void sub_9014();
void sub_473c();
void sub_8fa9();
void sub_43f0();
void CicoContext::cicocontext_t::callIndirect(int seg, int ofs)
{
    int a = seg*16+ofs;
//    sync();
    switch (a)
    {
        case 0x204d: sub_204d(); return;
        case 0x5d62: sub_5d62(); return;
        case 0x402e: return;
        case 0x8e60: sub_8e60(); return;
        case 0x9032: sub_9032(); return;
        case 0x43e0: sub_43e0(); return;
        case 0x45b7: sub_45b7(); return;
        case 0x9082: sub_9082(); return;
        case 0x4611: sub_4611(); return;
        case 0x4862: sub_4862(); return;
        case 0x4778: sub_4778(); return;
        case 0x8edf: sub_8edf(); return;
        case 0x4430: sub_4430(); return;
        case 0x8f3c: sub_8f3c(); return;
        case 0x4677: sub_4677(); return;
        case 0x90d3: sub_90d3(); return;
        case 0x4666: sub_4666(); return;
        case 0x86d9: sub_86d9(); return;
        case 0x90e2: sub_90e2(); return;
        case 0x44c3: sub_44c3(); return;
        case 0x8fb6: sub_8fb6(); return;
        case 0x9112: sub_9112(); return;
        case 0x47b2: sub_47b2(); return;
        case 0x9028: sub_9028(); return;
        case 0x8ed9: sub_8ed9(); return;
        case 0x444c: sub_444c(); return;
        case 0x8fa0: sub_8fa0(); return;
        case 0x4bde: sub_4bde(); return;
        case 0x4bd1: sub_4bd1(); return;
        case 0x4918: sub_4918(); return;
        case 0x8f74: sub_8f74(); return;
        case 0x4464: sub_4464(); return;
        case 0x1a50a: /* mouse */;
            ctx->_cs = pop(); // retf
            ctx->a.r16 = 0xffff;
            ctx->b.r16 = 3;
            
            return; //0A57:0000FF9A int 33
        case 0x4628: sub_4628(); return;
//        case 0xcbed: sub_1cbed(); return;
//        case 0xe5a1: sub_1e5a1(); return;
        case 0x8f86: sub_8f86(); return;
        case 0x4693: sub_4693(); return;
        case 0x4928: sub_4928(); return;
        case 0x9014: sub_9014(); return;
        case 0x473c: sub_473c(); return;
        case 0x8fa9: sub_8fa9(); return;
        case 0x43f0: sub_43f0(); return;
        default:
            assert(0);
    }
}

void CicoContext::cicocontext_t::cmc()
{
    ctx->carry = !ctx->carry;
}
void CicoContext::cicocontext_t::aaa()
{
    if ((ctx->a.r8.l & 0x0F) > 9 /*|| (r8[af] = 1)*/)
    {
        ctx->a.r8.l = (ctx->a.r8.l + 6) & 0x0f;
        ctx->a.r8.h ++;
        //af = 1;
        ctx->carry = 1;
    } else {
        ctx->carry = 0;
        //af = 0;
    }
}
namespace CicoContext {
void cicocontext_t::mul(uint8_t r)
{
    int v = r * ctx->a.r8.l;
    ctx->a.r16 = v & 0xffff;
}
void cicocontext_t::mul(uint16_t r)
{
    int v = r * ctx->a.r16;
    ctx->a.r16 = v & 0xffff;
    ctx->d.r16 = v >> 16;
}
void cicocontext_t::imul(uint16_t r)
{
    int v = (int16_t)ctx->a.r16 * (int16_t)r;
    ctx->a.r16 = v & 0xffff;
    ctx->d.r16 = v >> 16;
}
void cicocontext_t::imul(uint8_t r)
{
    int v = (char)r * (short)ctx->a.r16;
    ctx->a.r16 = v & 0xffff;
}
void cicocontext_t::idiv(uint16_t r)
{
    int32_t n = (ctx->d.r16 << 16) | ctx->a.r16;
    ctx->a.r16 = n / (int16_t)r;
    ctx->d.r16 = n % (int16_t)r;
}
void cicocontext_t::idiv(uint8_t r)
{
    int32_t dw = (ctx->d.r16 << 16) | ctx->a.r16;
    uint16_t result = dw / r;
    uint16_t remainder = dw % r;
    ctx->a.r16 = result;
    ctx->d.r16 = remainder;
}

uint8_t cicocontext_t::rcr(uint8_t r, int i)
{
    assert(i == 1);
    int newCarry = !!(r & 0x1);
    r >>= 1;
    r |= ctx->carry ? 0x80 : 0;
    ctx->carry = newCarry;
    return r;
}
uint8_t cicocontext_t::rcl(uint8_t r, int i)
{
    assert(i == 1);
    int newCarry = !!(r & 0x80);
    r <<= 1;
    r |= ctx->carry;
    ctx->carry = newCarry;
    return r;
}
uint16_t cicocontext_t::rcl(uint16_t r, int i)
{
    while (i > 0)
    {
        int newCarry = !!(r & 0x8000);
        r <<= 1;
        r |= ctx->carry ? 0x0001 : 0x0000;
        ctx->carry = newCarry;
        i--;
    }
    return r;
}
uint16_t cicocontext_t::rcr(uint16_t r, int i)
{
    while (i > 0)
    {
        int newCarry = !!(r & 0x0001);
        r >>= 1;
        r |= ctx->carry ? 0x8000 : 0x0000;
        ctx->carry = newCarry;
        i--;
    }
    return r;
}
template <typename INT>
INT _rol(INT val) {
    return (val << 1) | (val >> (sizeof(INT)*CHAR_BIT-1));
}

uint8_t cicocontext_t::rol(uint8_t r, int l)
{
    while (l--)
        r = _rol<uint8_t>(r);
    return r;
}
uint16_t cicocontext_t::rol(uint16_t r, int l)
{
    while (l--)
        r = _rol<uint16_t>(r);
    return r;
}
uint16_t cicocontext_t::sar(uint16_t a, uint8_t b)
{
    int16_t sa = (short)a;
    sa >>= b;
    return sa;
}
uint8_t cicocontext_t::sar(uint8_t a, uint8_t b)
{
    int8_t sa = (char)a;
    sa >>= b;
    return sa;
}

uint8_t cicocontext_t::ror(uint8_t r, int l)
{
    return (r >> l) | (r << (8-l));
}
uint16_t cicocontext_t::ror(uint16_t r, int l)
{
    return (r >> l) | (r << (16-l));
}
void cicocontext_t::sync(void)
{
    _sync();
}
void cicocontext_t::load(const char* path, const char* file, int size)
{
    char fpath[1024];
    sprintf(root, path);
    sprintf(fpath, "%s/%s", path, file);
    FILE* f = fopen(fpath, "rb");
    fread(mem, size, 1, f);
    fclose(f);
    headerSize = this->_headerSize;
}

}
void start();
int main(int argc, const char * argv[])
{
    CicoContext::ctx = new CicoContext::cicocontext_t();

    memset(mem, 0, sizeof(mem));

    mSdl.Init();
    start();
    mSdl.Deinit();
    return 0;
}


//#include "goose.cpp"


unsigned char font[2048] = {
  0x00, 0x00, 0x00, 0x00, 0x00, 0x00, 0x00, 0x00, 0x7e, 0x81, 0xa5, 0x81,
  0xbd, 0x99, 0x81, 0x7e, 0x7e, 0xff, 0xdb, 0xff, 0xc3, 0xe7, 0xff, 0x7e,
  0x6c, 0xfe, 0xfe, 0xfe, 0x7c, 0x38, 0x10, 0x00, 0x10, 0x38, 0x7c, 0xfe,
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  0x00, 0x00, 0x00, 0x00, 0x00, 0x00, 0x00, 0x00
};
